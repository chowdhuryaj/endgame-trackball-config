## twist_router/Kconfig
```kconfig
config ZMK_TWIST_ROUTER
	bool "Twist router: per mods/locks/layer rules for twist scroll"
	default y
	depends on DT_HAS_ZMK_INPUT_PROCESSOR_TWIST_ROUTER_ENABLED
	select ZMK_HID_INDICATORS

if ZMK_TWIST_ROUTER

config ZMK_TWIST_ROUTER_TAP_MS
	int "Key press/release spacing for the keys action (ms)"
	default 10

config ZMK_TWIST_ROUTER_MAX_PENDING_TAPS
	int "Max queued key taps per direction (extra twist is dropped)"
	default 8

endif
```

## twist_router/dts/bindings/input_processors/zmk,input-processor-twist-router.yaml
```yaml
description: Routes twist wheel events through runtime rules (mods / lock LEDs / layer)
compatible: "zmk,input-processor-twist-router"
include: ip_zero_param.yaml

properties:
  mode:
    type: int
    required: true
    description: 0 = twist (acts on REL_WHEEL), 1 = cursor (acts on REL_X/REL_Y)
```
